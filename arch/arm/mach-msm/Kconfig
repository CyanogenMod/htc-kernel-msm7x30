## drivers/media/video/msm/Kconfig
```kconfig
config MSM_CAMERA_V4L2
        bool "MSM Camera V4L2 Interface"
        depends on MSM_CAMERA
        default n
        ---help---
          This flag enables V4L2 interface of MSM
          camera driver. If enabled, application interacts
          with /dev/video0 through V4L2 APIs. Otherwise,
          native APIs are used through /dev/config0, /dev/frame0,
          and /dev/control0.

choice
        prompt "Qualcomm MSM camera and video capture support"
        depends on MSM_CAMERA
        default MSM_CAMERA_LEGACY

        config MSM_CAMERA_LEGACY
                bool "msm camera legacy"

        config MSM_CAMERA_7X30
                bool "msm camera 7x30"
        config MSM_CAMERA_8X60
                bool "msm camera 8x60"

endchoice

config 720P_CAMERA
        bool "Qualcomm MSM camera with 720P video support"
        depends on MSM_CAMERA_LEGACY
        help
          720P video support

config CAMERA_ZSL
       bool "Qualcomm MSM ZSL support"
       depends on MSM_CAMERA && ARCH_MSM8X60
       default n
       ---help---
         Enable support for ZSL

config CAMERA_3D
       bool "Qualcomm MSM 3D support"
       depends on MSM_CAMERA && ARCH_MSM8X60
       default n
       ---help---
         Enable support for 3D

config CAMERA_MULTISHOT
       bool "Qualcomm MSM Multishot support"
       depends on MSM_CAMERA && ARCH_MSM7X30
       default n
       ---help---
         Enable support for Multishot

config MSM_CAMERA_DEBUG
       bool "Qualcomm MSM camera debugging with printk"
       depends on MSM_CAMERA
       help
         Enable printk() debug for msm camera

config FLASH_BACKLIGHT_OFF
       bool "Turn off backlight when flash high"
       depends on MSM_CAMERA
       help
         Turn off backlight when flash high

comment "Camera Sensor Selection"
config MT9T013
	bool "Sensor mt9t013 (BAYER 3M)"
	depends on MSM_CAMERA && !ARCH_MSM8X60 && !ARCH_MSM8960 && !MSM_CAMERA_V4L2
	default y
	---help---
	  MICRON 3M Bayer Sensor with AutoFocus
config MT9D113
	bool "Sensor mt9d113 (YUV 2M)"
	depends on MSM_CAMERA && ARCH_MSM8X60 && !MSM_CAMERA_V4L2
	default y
	---help---
	  MICRON 2M YUV Sensor
	  This sensor is the front camera on QT8660.
	  This uses csi mipi interface.
	  This sensor is used only on QT device.
config MT9D112
	bool "Sensor mt9d112 (YUV 2M)"
	depends on MSM_CAMERA && !ARCH_MSM8X60 && !ARCH_MSM8960 && !MSM_CAMERA_V4L2
	default y
	---help---
	  MICRON 2M YUV Sensor
config IMX074
	bool "Sensor IMX074 (BAYER 13.5M)"
	depends on MSM_CAMERA && (ARCH_MSM8X60 || ARCH_MSM8960)
	default n
	---help---
	SONY 13.5 MP Bayer Sensor
config WEBCAM_OV7692
	bool "Sensor OV7692 (VGA YUV)"
	depends on MSM_CAMERA && ARCH_MSM8X60 && !MSM_CAMERA_V4L2
	default y
	---help---
	  Omni Vision VGA YUV Sensor.
config WEBCAM_OV9726
	bool "Sensor OV9726 (VGA Bayer)"
	depends on MSM_CAMERA && (ARCH_MSM8X60 || ARCH_MSM7X30 || ARCH_MSM7X27A) && !MSM_CAMERA_V4L2
	default n
	---help---
	  Omni Vision VGA Bayer Sensor.
#	This Senosr is used as a webcam.
#	This uses the CSI interface.
config VX6953
	bool "Sensor VX6953 (BAYER 5M)"
	depends on MSM_CAMERA && (ARCH_MSM7X30 || ARCH_MSM8X60)
	default y
	---help---
	STM 5M Bayer Sensor with EDOF
config SN12M0PZ
	bool "Sensor sn12m0pz (Bayer 12 MP)"
	depends on MSM_CAMERA && ARCH_MSM7X30 && !MSM_CAMERA_V4L2
	default y
	---help---
	  Sony 12 MP Bayer Sensor
config MT9P012
	bool "Sensor mt9p012 (BAYER 5M)"
	depends on MSM_CAMERA && !ARCH_MSM8X60 && !MSM_CAMERA_V4L2
	default y
	---help---
	  MICRON 5M Bayer Sensor with Autofocus

choice
	prompt "AF module"
	depends on MT9P012 && !ARCH_MSM8X60 && !MSM_CAMERA_V4L2
	default MSM_CAMERA_AF_FOXCONN

config MSM_CAMERA_AF_FOXCONN
	bool "FOXCONN Module"
	help
	  This driver supports FOXCONN AF module for 5M Bayer sensor

config MSM_CAMERA_AF_BAM
	bool "BAM Module"
	help
	  This driver supports BAM AF module for 5M Bayer sensor

endchoice

config MT9P012_KM
	bool "Sensor mt9p012 KM module (BAYER 5M)"
	depends on MSM_CAMERA && !ARCH_MSM8X60 && !MSM_CAMERA_V4L2
	default y
	---help---
	  MICRON 5M Bayer Sensor KM modules with Autofocus

config MT9E013
	bool "Sensor mt9e013 module (BAYER 8M)"
	depends on MSM_CAMERA && (ARCH_MSM7X30 || ARCH_MSM8X60 || ARCH_MSM7X27A) && !MSM_CAMERA_V4L2
	default n
	---help---
	  Aptina 8M Bayer Sensor modules with Autofocus

config IMX074_ACT
	bool "Actuator IMX074 (BAYER 13.5M)"
	depends on MSM_CAMERA && ARCH_MSM8960
	default n
	---help---
	Actuator for SONY 13.5 MP Bayer Sensor

config S5K3E2FX
	bool "Sensor s5k3e2fx (Samsung 5M)"
	depends on MSM_CAMERA && !ARCH_MSM8X60 && !MSM_CAMERA_V4L2
	default y
	---help---
	  Samsung 5M with Autofocus

config QS_S5K4E1
	bool "Sensor qs_s5k4e1 (Samsung 5M)"
	depends on MSM_CAMERA && ARCH_MSM8X60 && !MSM_CAMERA_V4L2
	default y
	---help---
	  Samsung 5M with Autofocus

config S5K4E1
	bool "Sensor Sensor s5k4e1 (Samsung 5M)"
	depends on MSM_CAMERA
	default n
	---help---
	  Support for S5k4E1 samsung sensor driver.
	  It is a Bayer 5MP sensor with auto focus and it supports
	  two mipi lanes, required for msm7x2xA platform.
	  Say Y here if this is msm7x2xA variant platform.

config S5K4E5YX
        bool "Sensor s5k4e5yx (Samsung 5M)"
        depends on MSM_CAMERA
        default n
        ---help---
          Samsung 5M with Autofocus
	  
config S5K3H1GX
  bool "Sensor s5k3h1gx"
  depends on MSM_CAMERA
  default n
  ---help---
    Samsung 8M 3H1 MIPI AF Sensor

config MSM_CAMERA_FLASH_SC628A
	bool "Qualcomm MSM camera sc628a flash support"
	depends on MSM_CAMERA
	default n
	---help---
	  Enable support for LED flash for msm camera.
	  It is a samtech charge pump flash driver and it
	  supports spotlight and flash light modes with
	  differrent current levels.

config IMX072
	bool "Sensor imx072 (Sony 5M)"
	default n
	---help---
	  Support for IMX072 sony sensor driver.
	  It is a Bayer 5MP sensor with auto focus and it supports
	  two mipi lanes, required for msm7x2xA platform.
	  Say Y here if this is msm7x2xA variant platform.

config OV2720
	bool "Sensor ov2720 (Omnivision 2MP)"
	depends on MSM_CAMERA && ARCH_MSM8960
	default n

config QS_MT9P017
	bool "Sensor qs_mt9p017 (Aptina 3D 5M)"
	depends on MSM_CAMERA
	---help---
	  Aptina 3D 5M with Autofocus

config VB6801
	bool "Sensor vb6801"
	depends on MSM_CAMERA && !ARCH_MSM8X60 && !MSM_CAMERA_V4L2
	---help---
	  5M with flash

config MSM_CAMERA_FLASH
	bool "Qualcomm MSM camera flash support"
	depends on MSM_CAMERA
	default n
	---help---
	  Enable support for LED flash for msm camera

config MSM_CAMERA_SENSOR
	bool "Qualcomm MSM camera sensor support"
	depends on MSM_CAMERA

config MSM_ACTUATOR
	bool "Qualcomm MSM actuator support"
	depends on MSM_CAMERA

config MSM_GEMINI
	tristate "Qualcomm MSM Gemini Jpeg Engine support"
	depends on MSM_CAMERA && (ARCH_MSM7X30 || ARCH_MSM8X60 || ARCH_MSM8960)
	default n
	---help---
	  Enable support for Gemini Jpeg Engine

config MSM_VPE
	tristate "Qualcomm MSM Video Pre-processing Engine support"
	depends on MSM_CAMERA && (ARCH_MSM7X30 || ARCH_MSM8X60)
	default y
	---help---
	  Enable support for Video Pre-processing Engine

config RAWCHIP
	bool "Rawchip"
	depends on MSM_CAMERA
	default n
	---help---
	  ST Yushan rawchip

config QUP_EXCLUSIVE_TO_CAMERA
	bool "QUP exclusive to camera"
	depends on MSM_CAMERA
	default y
	---help---
	  This flag enabled states that QUP
	  is exclusive to camera. In case this
	  is disabled, the lvs1 voltage is enabled
	  by QUP in the board file as QUP is used by
	  applications other than camera.

config S5K3H2YX
	bool "Sensor s5k3h2yx (Samsung 8M)"
	depends on MSM_CAMERA
	default n
	---help---
	  Support for S5K3H2YX samsung sensor driver.
	  It is a Bayer 8MP sensor with auto focus and it supports
	  two mipi lanes.

config S5K3H2YX_ACT
	bool "Sensor s5k3h2yx actuator"
	depends on MSM_CAMERA
	default n
	---help---
	  Autofocus of s5k3h2yx actuator

config S5K4E5YX
	bool "Sensor s5k4e5yx (Samsung 5M)"
	depends on MSM_CAMERA
	default n
	---help---
	  Samsung 5M with Autofocus

config S5K4E5YX_ACT
	bool "Sensor s5k4e5yx actuator"
	depends on MSM_CAMERA
	default n
	---help---
	  Autofocus of s5k4e5yx actuator

config MT9V113
	bool "Sensor mt9v113 (VGA YUV)"
	depends on MSM_CAMERA
	default n
	---help---
	  Support for MT9V113 Micron sensor driver.
	  It is a Bayer 0.3MP sensor it supports two mipi lanes.

config S5K6A1GX
	bool "Sensor s5k6a1gx (Samsung 1.3M)"
	default n
	---help---
	  Support for S5K6A1GX samsung sensor driver.
	  It is a Bayer 1.3MP sensor it supports one mipi lanes.

config S5K6AAFX
	bool "Sensor s5k6aafx (Samsung 1.3M)"
	depends on MSM_CAMERA
	default n
	---help---
	  Samsung 1.3M without Autofocus

config OV8830
	bool "Sensor ov8830"
	depends on MSM_CAMERA
	default n
	---help---
	  OmniVision 8M Bayer Sensor

config MT9D015
	bool "Sensor mt9d015 (Aptina 2M)"
	depends on MSM_CAMERA && ARCH_MSM8X60 && !MSM_CAMERA_V4L2
	default n
	---help---
	  Aptina 2M with Autofocus

config SP3D
	bool "Sensor SP3D (Sharp 3D module)"
	depends on MSM_CAMERA && ARCH_MSM8X60
	default n
	---help---
	  SHARP 3D Module

config QS_S5K4E1
	bool "Sensor qs_s5k4e1 (Samsung 5M)"
	depends on MSM_CAMERA && ARCH_MSM8X60 && !MSM_CAMERA_V4L2
	default n
	---help---
	  Samsung 5M with Autofocus
```

## drivers/misc/ts27010mux_uart/Kconfig
```kconfig
#
# TS 27.010 configuration
#

menu "Motorola TS 27.010 Mux driver over UART"

config MOT_FEAT_TS27010MUX_UART
        tristate "Motorola TS 27.010 Mux driver over UART"
        default n

endmenu
```

## drivers/net/wimax/Kconfig
```kconfig
#
# WiMAX LAN device drivers configuration
#


comment "Enable WiMAX (Networking options) to see the WiMAX drivers"
	depends on WIMAX = n

if WIMAX

menu "WiMAX Wireless Broadband devices"

source "drivers/net/wimax/i2400m/Kconfig"
source "drivers/net/wimax/SQN/Kconfig"

endmenu

endif
config WIMAX_SERIAL_MSM
	tristate "WIMAX uart debug console support"
	depends on WIMAX && SERIAL_MSM
	default n
	---help---
	  This module adds support for wimax chip console based on
	  UART port interface.

	  Need define CONFIG_SERIAL_MSM as pre-condition to enable BSP UART.
```

## drivers/net/wimax/SQN/Kconfig
```kconfig
config WIMAX_SQN
	tristate "WiMAX SQN1210 cards support"
	depends on WIMAX && MMC
	---help---
	  This module adds support for wimax adapters based on
	  SQN1120 chipset.

	  This driver uses the kernel's wimax subsystem.

	  If you choose to build a module, it'll be called sequans_sdio. Say M if
	  unsure.

config WIMAX_SDIO_HIGH_SPEED
	tristate "WiMAX SDC CLK 48M support"
	help
	 yes means SDC CLK to 48M
```

## drivers/net/wireless/bcm4329/Kconfig
```kconfig
config BCM4329
	tristate "Broadcom 4329 wireless cards support"
	depends on MMC
	select WIRELESS_EXT
	select WEXT_PRIV
	---help---
	  This module adds support for wireless adapters based on
	  Broadcom 4329 chipset.

	  This driver uses the kernel's wireless extensions subsystem.

	  If you choose to build a module, it'll be called dhd. Say M if
	  unsure.

config BCM4329_FW_PATH
	depends on BCM4329
	string "Firmware path"
	default "/system/etc/firmware/fw_bcm4329.bin"
	---help---
	  Path to the firmware file.

config BCM4329_NVRAM_PATH
	depends on BCM4329
	string "NVRAM path"
	default "/proc/calibration"
	---help---
	  Path to the calibration file.

config BCM4329_ENABLE_CSCAN
	depends on BCM4329
	bool "Enable CSCAN"
	default n
	---help---
	  Enable the use of CSCAN methods.

config BCM4329_ALLOW_ARP
	depends on BCM4329
	bool "Allow ARP requests"
	default n
	---help---
	  Allow ARP requests to be received by the cpu while in low
	  power mode.
```

## drivers/net/wireless/qualcomm_wlan/Kconfig
```kconfig
config QUALCOMM_WLAN
	tristate "Qualcomm wireless cards support"

	---help---
	  This module adds support for wireless adapters based on
	  Qualcomm chipset.
```

## drivers/staging/android/Kconfig
```kconfig
menu "Android"

config ANDROID
	bool "Android Drivers"
	default N
	---help---
	  Enable support for various drivers needed on the Android platform

if ANDROID

config ANDROID_BINDER_IPC
	bool "Android Binder IPC Driver"
	default n

config ANDROID_LOGGER
	tristate "Android log driver"
	default n

config ANDROID_RAM_CONSOLE
	bool "Android RAM buffer console"
	default n

config ANDROID_RAM_CONSOLE_ENABLE_VERBOSE
	bool "Enable verbose console messages on Android RAM console"
	default y
	depends on ANDROID_RAM_CONSOLE

menuconfig ANDROID_RAM_CONSOLE_ERROR_CORRECTION
	bool "Android RAM Console Enable error correction"
	default n
	depends on ANDROID_RAM_CONSOLE
	depends on !ANDROID_RAM_CONSOLE_EARLY_INIT
	select REED_SOLOMON
	select REED_SOLOMON_ENC8
	select REED_SOLOMON_DEC8

if ANDROID_RAM_CONSOLE_ERROR_CORRECTION

config ANDROID_RAM_CONSOLE_ERROR_CORRECTION_DATA_SIZE
	int "Android RAM Console Data data size"
	default 128
	help
	  Must be a power of 2.

config ANDROID_RAM_CONSOLE_ERROR_CORRECTION_ECC_SIZE
	int "Android RAM Console ECC size"
	default 16

config ANDROID_RAM_CONSOLE_ERROR_CORRECTION_SYMBOL_SIZE
	int "Android RAM Console Symbol size"
	default 8

config ANDROID_RAM_CONSOLE_ERROR_CORRECTION_POLYNOMIAL
	hex "Android RAM Console Polynomial"
	default 0x19 if (ANDROID_RAM_CONSOLE_ERROR_CORRECTION_SYMBOL_SIZE = 4)
	default 0x29 if (ANDROID_RAM_CONSOLE_ERROR_CORRECTION_SYMBOL_SIZE = 5)
	default 0x61 if (ANDROID_RAM_CONSOLE_ERROR_CORRECTION_SYMBOL_SIZE = 6)
	default 0x89 if (ANDROID_RAM_CONSOLE_ERROR_CORRECTION_SYMBOL_SIZE = 7)
	default 0x11d if (ANDROID_RAM_CONSOLE_ERROR_CORRECTION_SYMBOL_SIZE = 8)

config MDM9K_ERROR_CORRECTION
	bool "collect mdm9k error message"
	default n
	depends on ANDROID_RAM_CONSOLE_ERROR_CORRECTION
	help
	  collect mdm9k error message and append into lastkmsg.

endif # ANDROID_RAM_CONSOLE_ERROR_CORRECTION

config ANDROID_RAM_CONSOLE_EARLY_INIT
	bool "Start Android RAM console early"
	default n
	depends on ANDROID_RAM_CONSOLE

config ANDROID_RAM_CONSOLE_EARLY_ADDR
	hex "Android RAM console virtual address"
	default 0
	depends on ANDROID_RAM_CONSOLE_EARLY_INIT

config ANDROID_RAM_CONSOLE_EARLY_SIZE
	hex "Android RAM console buffer size"
	default 0
	depends on ANDROID_RAM_CONSOLE_EARLY_INIT

config ANDROID_TIMED_OUTPUT
	bool "Timed output class driver"
	default y

config ANDROID_TIMED_GPIO
	tristate "Android timed gpio driver"
	depends on GENERIC_GPIO && ANDROID_TIMED_OUTPUT
	default n

config ANDROID_LOW_MEMORY_KILLER
	bool "Android Low Memory Killer"
	default N
	---help---
	  Register processes to be killed when memory is low

config ANDROID_RADIO_LOG_SIZE
	int "THE SIZE OF RADIO LOG FOR STAGING ANDROID LOGGER"
	range 32 512
	default 256
	help
	  Determine the size of radio log - kbytes

config ANDROID_DEVICE_LOG_SIZE
	int "THE SIZE OF DEVICE(MAIN) LOG FOR STAGING ANDROID LOGGER"
	range 32 512
	default 256
	help
	  Determine the size of device log - kbytes

config ANDROID_SYSTEM_LOG_SIZE
	int "THE SIZE OF SYSTEM LOG FOR STAGING ANDROID LOGGER"
	range 32 512
	default 256
	help
		Determine the size of system log - kbytes

config ANDROID_EVENTS_LOG_SIZE
	int "THE SIZE OF EVENTS LOG FOR STAGING ANDROID LOGGER"
	range 32 512
	default 256
	help
		Determine the size of events log - kbytes

endif # if ANDROID

endmenu
```
