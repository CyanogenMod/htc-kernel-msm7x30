## block/Kconfig.iosched
```kconfig
if BLOCK

menu "IO Schedulers"

config IOSCHED_NOOP
	bool
	default y
	---help---
	  The no-op I/O scheduler is a minimal scheduler that does basic merging
	  and sorting. Its main uses include non-disk based block devices like
	  memory devices, and specialised software or hardware environments
	  that do their own scheduling and require only minimal assistance from
	  the kernel.

config IOSCHED_AS
	tristate "Anticipatory I/O scheduler"
	default y
	---help---
	  The anticipatory I/O scheduler is generally a good choice for most
	  environments, but is quite large and complex when compared to the
	  deadline I/O scheduler, it can also be slower in some cases
	  especially some database loads.

config IOSCHED_DEADLINE
	tristate "Deadline I/O scheduler"
	default y
	---help---
	  The deadline I/O scheduler is simple and compact, and is often as
	  good as the anticipatory I/O scheduler, and in some database
	  workloads, better. In the case of a single process performing I/O to
	  a disk at any one time, its behaviour is almost identical to the
	  anticipatory I/O scheduler and so is a good choice.

config IOSCHED_CFQ
	tristate "CFQ I/O scheduler"
	default y
	---help---
	  The CFQ I/O scheduler tries to distribute bandwidth equally
	  among all processes in the system. It should provide a fair
	  working environment, suitable for desktop systems.
	  This is the default I/O scheduler.

config IOSCHED_BFQ
	tristate "BFQ I/O scheduler"
	depends on EXPERIMENTAL
	default n
	---help---
	  The BFQ I/O scheduler tries to distribute bandwidth among
	  all processes according to their weights.
	  It aims at distributing the bandwidth as desired, independently of
	  the disk parameters and with any workload. It also tries to
	  guarantee low latency to interactive and soft real-time
	  applications.  If compiled built-in (saying Y here), BFQ can
	  be configured to support hierarchical scheduling.

config CGROUP_BFQIO
	bool "BFQ hierarchical scheduling support"
	depends on CGROUPS && IOSCHED_BFQ=y
	default n
	---help---
	  Enable hierarchical scheduling in BFQ, using the cgroups
	  filesystem interface.  The name of the subsystem will be
	  bfqio.

choice
	prompt "Default I/O scheduler"
	default DEFAULT_CFQ
	help
	  Select the I/O scheduler which will be used by default for all
	  block devices.

	config DEFAULT_AS
		bool "Anticipatory" if IOSCHED_AS=y

	config DEFAULT_DEADLINE
		bool "Deadline" if IOSCHED_DEADLINE=y

	config DEFAULT_CFQ
		bool "CFQ" if IOSCHED_CFQ=y

	config DEFAULT_BFQ
		bool "BFQ" if IOSCHED_BFQ=y

	config DEFAULT_NOOP
		bool "No-op"

endchoice

config DEFAULT_IOSCHED
	string
	default "anticipatory" if DEFAULT_AS
	default "deadline" if DEFAULT_DEADLINE
	default "cfq" if DEFAULT_CFQ
	default "bfq" if DEFAULT_BFQ
	default "noop" if DEFAULT_NOOP

endmenu

endif
```

## drivers/btport/Kconfig
```kconfig
#
# BRCM BT Port Driver
#

menuconfig BTPORT
	bool "BT port support"
	default n
	---help---
	  Redirect DUN & SPP driver to a fixed device node

if BTPORT

config BTPORT_DRV
	tristate "BRCM BT Port Support"
	default n
	---help---

endif # BTPORT
```

## drivers/char/diag/Kconfig
```kconfig
menu "Diag Support"

config DIAG_CHAR
	tristate "char driver interface and diag forwarding to/from modem"
	default m
	depends on USB_G_ANDROID || USB_FUNCTION_DIAG || USB_QCOM_MAEMO
	depends on ARCH_MSM
	help
	 Char driver interface for diag user space and diag-forwarding to modem ARM and back.
	 This enables diagchar for maemo usb gadget or android usb gadget based on config selected.
endmenu

menu "DIAG traffic over USB"

config DIAG_OVER_USB
	bool "Enable DIAG traffic to go over USB"
        depends on ARCH_MSM
	default y
	help
	 This feature helps segregate code required for DIAG traffic to go over USB.

config MODEM_DIAG_MASTER
	bool "Set if Modem is to be the master on DIAG"
	depends on ARCH_MSM
	default n
	help
	 Diag master: Android just forwards the Diag packet to modem. Modem will remove HDLC by itself.
	 Diag slave: Android kernel should remove HDLC from Diag packet before send to modem.
	 In the latest modem codebase, it was n by default.
endmenu

menu "SDIO support for DIAG"

config DIAG_SDIO_PIPE
	depends on MSM_SDIO_AL
	default y
	bool "Enable 9K DIAG traffic over SDIO"
	help
	 SDIO Transport Layer for DIAG Router
endmenu
```

## drivers/gpu/Kconfig
```kconfig
# Added by HTC Display/Graphics for msm gpu driver

config MSM_KGSL_ADRENO200
        bool "MSM 3D Graphics driver for Adreno200"
        depends on FB_MSM && ARCH_MSM7X27A
        default y
        help
          3D graphics driver for Adreno200. Required to
          use hardware accelerated OpenGL ES 2.0 and 1.1 on these
          chips.

config MSM_KGSL_ADRENO205
        bool "MSM 3D Graphics driver for Adreno205"
        depends on FB_MSM && ARCH_MSM7X30
        default y
        help
          3D graphics driver for Adreno205. Required to
          use hardware accelerated OpenGL ES 2.0 and 1.1 on these
          chips.

config MSM_KGSL_ADRENO220
        bool "MSM 3D Graphics driver for Adreno220"
        depends on FB_MSM && ARCH_MSM8X60
        default y
        help
          3D graphics driver for Adreno220. Required to
          use hardware accelerated OpenGL ES 2.0 and 1.1 on these
          chips.

config MSM_KGSL_ADRENO225
        bool "MSM 3D Graphics driver for Adreno225"
        depends on FB_MSM && ARCH_MSM8960
        default y
        help
          3D graphics driver for Adreno225. Required to
          use hardware accelerated OpenGL ES 2.0 and 1.1 on these
          chips.

if MSM_KGSL_ADRENO200
source "drivers/gpu/msm_adreno200/Kconfig"
endif

if MSM_KGSL_ADRENO205
source "drivers/gpu/msm_adreno205/Kconfig"
endif

if MSM_KGSL_ADRENO220
source "drivers/gpu/msm_adreno220/Kconfig"
endif

if MSM_KGSL_ADRENO225
source "drivers/gpu/msm/Kconfig"
endif
```

## drivers/i2c/chips/Kconfig
```kconfig
#
# Miscellaneous I2C chip drivers configuration
#
# *** DEPRECATED! Do not add new entries! See Makefile ***
#

menu "Miscellaneous I2C Chip support"


config SENSORS_ONLY_BMA250
	tristate "BMA250 acceleration sensor support"
	depends on I2C=y
	help
	  BMA250 ONLY G-sensor Driver implemented by HTC.

config SENSORS_I2C_AK_BMA250
	tristate "BMA250 acceleration sensor without AKM support(SH)"
	depends on I2C=y
	help
	 BMA250 ONLY G-sensor Driver implemented by HTC.

config SENSORS_AKM8975
        tristate "AKM8973 Compass Driver"
        depends on I2C
        help
         AKM8975 Compass Driver implemented by HTC.

config SENSORS_AKM8975_PANA_GYRO
        tristate "AKM8973 Compass Driver for Pana Gyro"
        depends on I2C
        help
         AKM8975 Compass Driver implemented by HTC.

config SENSORS_PANASONIC_GYRO
	tristate "PANASONIC GYRO sensor support"
	depends on I2C=y
	help

config TPS65200
        tristate "tps65200 Driver"
        depends on I2C
        help
         TPS65200 Switch charger implemented by HTC.
         This could enable battery driver to set
         Charging current 100mA~500mA or 500mA~1000mA
         by GPIO or Register

	  PANASONIC GYR Driver implemented by HTC.

config SENSORS_BMA250
	tristate "BMA250 acceleration sensor support"
	depends on I2C=y
	help
	  BMA250 G-sensor Driver implemented by HTC.

config SENSORS_NFC_PN544
	tristate "PN544 NFC sensor support"
	depends on I2C=y
	help
	  PN544 NFC Driver implemented.

config INPUT_CAPELLA_CM3628
	tristate "CM3628 proximity and light sensor"
	help
	  Say Y here to enable the CM3628 Short Distance Proximity
	  Sensor with Ambient Light Sensor.

config INPUT_CAPELLA_CM3629
	tristate "CM3629 proximity and light sensor"
	help
	  Say Y here to enable the CM3629 Short Distance Proximity
	  Sensor with Ambient Light Sensor.

config VP_A1026
	tristate "A1026 Voice Processor Driver"
	depends on I2C
	help
	  A1026 Voice Processor Driver implemented by HTC.

config VP_A1028
	tristate "A1028 Voice Processor Driver"
	depends on I2C=y
	default n
	help
	 A1028 Voice Processor Driver implemented by HTC.

config AMP_TPA2051D3
        tristate "TI TPA2051D3 Speaker AMP Driver"
	depends on I2C=y
        help
         TI TPA2051D3 Speaker AMP Driver implemented by HTC.

config INPUT_ISL29028
	tristate "ISL29028 proximity and light sensor"
	help
	  Say Y here to enable the ISL29028 Short Distance Proximity
	  Sensor with Ambient Light Sensor.

config INPUT_ISL29029
	tristate "ISL29029 proximity and light sensor"
	help
	 Say Y here to enable the ISL29029 Short Distance Proximity
	 Sensor with Ambient Light Sensor.

config AMP_TPA2051D3_ON_GPIO
	tristate "TI TPA2051D3 Speaker AMP Driver on gpio"
	depends on AMP_TPA2051D3
	default n
	help
	 TI TPA2051D3_ON_GPIO Speaker AMP Driver implemented by HTC.

config CODEC_AIC3254
	tristate "Codec AIC3254 support"
	depends on I2C=y
	help
	  AIC3254 Driver implemented by HTC.

config CODEC_AIC3008
	tristate "Codec AIC3008 support"
	depends on I2C=y
	help
	  AIC3008 Driver implemented by HTC.

endmenu
```

## drivers/input/opticaljoystick/Kconfig
```kconfig
#
# opticaljoystick driver configuration
#
menuconfig INPUT_OPTICALJOYSTICK
	bool "Opticaljoystick"
	help
	  Say Y here, and a list of supported optical joystick will be displayed.
	  This option doesn't affect the kernel.

	  If unsure, say Y.

if INPUT_OPTICALJOYSTICK

config OPTICALJOYSTICK_CRUCIAL
	boolean

choice
	prompt "Interface"

config OPTICALJOYSTICK_CRUCIAL_uP
	boolean "Crucial Optical Joystick (microP)"
	depends on MICROP_COMMON
	select OPTICALJOYSTICK_CRUCIAL
	help

config OPTICALJOYSTICK_CRUCIAL_SPI
	boolean "Crucial Optical Joystick (SPI)"
	depends on SPI_CRUCIAL_OJ
	select OPTICALJOYSTICK_CRUCIAL
	help

endchoice

endif
```
