## drivers/usb/function/Kconfig
```kconfig
menu "USB Function Support"

config USB_FUNCTION
	boolean "Support for USB Function Drivers"
	help
	   The USB Function framework is similar to the Gadget framework
	   but a little simpler and a little more plugable.  It trades
	   some flexibility in the framework for smaller and simpler
	   function drivers that can be combined into a composite driver.

choice
	prompt "USB Peripheral Controller"
	depends on USB_FUNCTION
	
config USB_FUNCTION_MSM_HSUSB
	boolean "MSM7K Highspeed USB Peripheral Controller"
	depends on ARCH_MSM

endchoice

config USB_FUNCTION_NULL
	boolean "Null Function -- eats packets"
	depends on USB_FUNCTION

config USB_FUNCTION_ZERO
	boolean "Zero Function -- generates packets"
	depends on USB_FUNCTION

config USB_FUNCTION_LOOPBACK
	boolean "Loopback Function -- returns packets"
	depends on USB_FUNCTION

config USB_FUNCTION_ADB
	boolean "ADB Transport Function"
	depends on USB_FUNCTION

config USB_FUNCTION_UMS
	boolean "USB Mass Storage Function (userspace)"
	depends on USB_FUNCTION

config USB_FUNCTION_MASS_STORAGE
	boolean "USB Mass Storage Function (kernel based)"
	depends on USB_FUNCTION

config USB_FUNCTION_DIAG
	boolean "USB MSM7K Diag Function"
	depends on USB_FUNCTION

config USB_FUNCTION_ETHER
	boolean "USB Ethernet Function"
	depends on USB_FUNCTION
config USB_FUNCTION_RNDIS
        boolean "USB RNDIS support"
        depends on USB_FUNCTION_ETHER
        default y

config USB_FUNCTION_FSYNC
	boolean "USB MSM7K FSYNC Function"
	depends on USB_FUNCTION

config USB_FUNCTION_SERIAL
	boolean "USB SERIAL Function"
	depends on USB_FUNCTION

config USB_FUNCTION_PROJECTOR
	boolean "USB PROJECTOR Function"
	depends on USB_FUNCTION

config USB_FUNCTION_MTP_TUNNEL
	boolean "MTP Tunnel Transport Function"
	depends on USB_FUNCTION

config USB_FUNCTION_MODEM
	boolean "USB MODEM Function"
	depends on USB_FUNCTION

config USB_BYPASS_VBUS_NOTIFY
	boolean "USB BYPASS VBUS NOTIFY"
	depends on USB_FUNCTION
	default n

config USB_FUNCTION_CAT_KIT
	boolean "USB FUNCTION CAT KIT"
	depends on USB_FUNCTION
	default n

endmenu
```

## drivers/video/msm/Kconfig
```kconfig
source "drivers/video/msm/vidc/Kconfig"
config FB_MSM
	tristate
	depends on FB && ARCH_MSM
	select FB_CFB_FILLRECT
	select FB_CFB_COPYAREA
	select FB_CFB_IMAGEBLIT
	default y

config FB_MSM_LEGACY_MDP
	bool
	depends on FB_MSM && (MSM_MDP30 || MSM_MDP31 || MSM_MDP302)
	default y

config FB_MSM_MDP_PPP
	bool
	depends on FB_MSM_LEGACY_MDP
	default y

config FB_MSM_LCDC
	bool "Support for integrated LCD controller in qsd8x50 ,MSM7x27 and MSM7x30"
	depends on FB_MSM && (MSM_MDP31 || MSM_MDP302 || MSM_MDP40)
	default y

config FB_MSM_DTV
	bool "Support for TV-Out in qsd8x50"
	depends on FB_MSM && MSM_MDP40
	default n

config FB_MSM_TVOUT
	bool "Support for TV-Out in qsd8x50"
	depends on FB_MSM && (MSM_MDP31 || MSM_MDP40)
	default n

config FB_MSM_OVERLAY
	bool "Support for overlay in MSM7X30"
	depends on FB_MSM && MSM_MDP40
	default y

config FB_MSM_DTV
	depends on FB_MSM_OVERLAY
	bool
	default n

config FB_MSM_MDP_ABL
        bool "Support QCT auto backlight scaling"
        depends on FB_MSM && (MSM_MDP40)
        default n

config GPU_MSM_KGSL
	tristate "MSM 3D Graphics driver for QSD8x50 and MSM7x27"
	default n
	depends on FB_MSM && (ARCH_QSD8X50 || ARCH_MSM7227 || ARCH_MSM7X30)
	select GENERIC_ALLOCATOR
	select CONFIG_FW_LOADER
	help
	  3D graphics driver for QSD8x50 and MSM7x27. Required to
	  use hardware accelerated OpenGL ES 2.0 and 1.1 on these
	  chips.

config GPU_MSM_KGSL_ADRENO205
        bool "MSM 3D Graphics driver for Adreno205"
        depends on FB_MSM && GPU_MSM_KGSL && ARCH_MSM7X30
        default y
        help
          3D graphics driver for Adreno205. Required to
          use hardware accelerated OpenGL ES 2.0 and 1.1 on these
          chips.


config MSM_KGSL_2D
	bool "Enable the 2D core. Required for OpenVG"
	default y
	depends on GPU_MSM_KGSL && GPU_MSM_KGSL_ADRENO205


config MSM_ROTATOR
        tristate "MSM Offline Image Rotator Driver"
        depends on ARCH_MSM7X30 && ANDROID_PMEM
        default y
        help
          This driver provides support for the image rotator HW block in the
          MSM 7x30 SoC.

config MSM_ROTATOR_USE_IMEM
        bool "Enable rotator driver to use iMem"
        depends on MSM_ROTATOR
        default y
        help
          This option enables the msm_rotator driver to use the move efficient
          iMem.  Some MSM platforms may not have iMem available for the rotator
          block.  Or some systems may want the iMem to be dedicated to a
          different function.

config MSM_KGSL_MMU
	bool "Turn on MMU for graphics driver "
	depends on GPU_MSM_KGSL && MMU
	default n
	help
	  If enabled, the GPU driver will allocate memory from vmalloc
	  and enable the use of GPU MMU, instead of using pmem.

config MSM_KGSL_PER_FD_PAGETABLE
        bool "Turn on per-fd pagetable for MMU of graphics driver "
        depends on MSM_KGSL_MMU && MMU
        default n
        help
         If enabled, the MMU unit of GPU driver will use seperate
         pagetables for each file descriptor

config MSM_KGSL_MMU_PAGE_FAULT
	bool "Force the GPU MMU to page fault for unmapped regions"
	default n
	depends on MSM_KGSL_MMU && !MSM_KGSL_DRM

config MSM_KGSL_PSTMRTMDMP_CP_STAT_NO_DETAIL
	bool "Disable human readable CP_STAT fields in post-mortem dump"
	default n
	depends on MSM_KGSL_MMU
	---help---
	  For a more compact kernel log the human readable output of
	  CP_STAT can be turned off with this option.

config MSM_KGSL_PSTMRTMDMP_NO_IB_DUMP
	bool "Disable dumping current IB1 and IB2 in post-mortem dump"
	default n
	depends on MSM_KGSL_MMU
	---help---
	  For a more compact kernel log the IB1 and IB2 embedded dump
	  can be turned off with this option.  Some IB dumps take up
	  so much space that vital other information gets cut from the
	  post-mortem dump.

config MSM_KGSL_PSTMRTMDMP_RB_HEX
	bool "Use hex version for ring-buffer in post-mortem dump"
	default n
	depends on MSM_KGSL_MMU
	---help---
	  Use hex version for the ring-buffer in the post-mortem dump, instead
	  of the human readable version.

config MSM_KGSL_PSTMRTMDMP_NO_REG_DUMP
	bool "Disable dumping of most registers in post-mortem dump"
	default n
	depends on MSM_KGSL_MMU
	---help---
	  For a more compact kernel log the extensive register hex dump
	  can be turned off with this option.  The register dump takes up
	  so much space that vital other information gets cut from the
	  post-mortem dump.

config MSM_HDMI_COMMON
	bool "Turn on HDMI common interface"
	depends on FB_MSM_OVERLAY && MSM_MDP40
	bool
	default n

config MSM_HDMI
	bool "Support for HDMI in QCT platform"
	depends on MSM_MDP31 || MSM_MDP40
	default n

config MSM_HDMI_MHL
	bool "Turn on MHL chip driver"
	depends on FB_MSM_OVERLAY && MSM_MDP40
	bool
	default n
```

## drivers/video/msm/gpu/kgsl_adreno205/Kconfig
```kconfig
config MSM_KGSL
	tristate "MSM 3D Graphics driver"
	default n
	depends on FB && ARM && ARCH_MSM && !MSM_HW3D && ANDROID_PMEM
	select GENERIC_ALLOCATOR
	select FW_LOADER
	---help---
	  3D graphics driver. Required to use hardware accelerated
	  OpenGL ES 2.0 and 1.1.

config MSM_KGSL_2D
	bool "Enable the 2D core. Required for OpenVG"
	default n
	depends on MSM_KGSL && !ARCH_MSM7X27

config MSM_KGSL_DRM
	bool "Build a DRM interface for the MSM_KGSL driver"
	depends on MSM_KGSL && DRM

config MSM_KGSL_MMU
	bool "Enable the GPU MMU in the MSM_KGSL driver"
	depends on MSM_KGSL && MMU
	default y

config KGSL_PER_PROCESS_PAGE_TABLE
	bool "Enable Per Process page tables for the KGSL driver"
	default n
	depends on MSM_KGSL_MMU && !MSM_KGSL_DRM

config MSM_KGSL_MMU_PAGE_FAULT
	bool "Force the GPU MMU to page fault for unmapped regions"
	default n
	depends on MSM_KGSL_MMU && !MSM_KGSL_DRM
```

## drivers/video/msm/vidc/Kconfig
```kconfig
#
# VIDEO CORE
#
menuconfig VIDC
	bool "Video Core Driver"
	depends on ARCH_MSM7X30 || ARCH_MSM8x60
	default y
	---help---
	Say Y here to see options for video device drivers.
	If you say N, all options in this submenu will be skipped and disabled.

menuconfig VIDC_720P
	bool "720P Video Core"
	depends on VIDC && ARCH_MSM7X30
	default y
	help
	  This option enables 720P Video core.

config VIDC_VENC
	tristate "Video encoder"
	depends on VIDC
	default y
	help
	  This option enables support for Video encoder.

config VIDC_VDEC
	tristate "Video decoder"
	depends on VIDC
	default y
	help
	  This option enables support for Video decoder.
```

## drivers/video/msm_7x30/Kconfig
```kconfig
config FB_MSM
	tristate
	depends on FB && ARCH_MSM
	select FB_CFB_FILLRECT
	select FB_CFB_COPYAREA
	select FB_CFB_IMAGEBLIT
	default y

config FB_MSM_LEGACY_MDP
	bool
	depends on FB_MSM && (MSM_MDP30 || MSM_MDP31 || MSM_MDP302)
	default y

config FB_MSM_MDP_PPP
	bool
	depends on FB_MSM_LEGACY_MDP
	default y

config FB_MSM_LCDC
	bool "Support for integrated LCD controller in qsd8x50 ,MSM7x27 and MSM7x30"
	depends on FB_MSM && (MSM_MDP31 || MSM_MDP302 || MSM_MDP40)
	default n

config FB_MSM_DTV
	bool "Support for TV-Out in qsd8x50"
	depends on FB_MSM && MSM_MDP40
	default n

config FB_MSM_TVOUT
	bool "Support for TV-Out in qsd8x50"
	depends on FB_MSM && (MSM_MDP31 || MSM_MDP40)
	default n

config FB_MSM_OVERLAY
	bool "Support for overlay in MSM7X30"
	depends on FB_MSM && MSM_MDP40
	default y

config FB_MSM_DTV
	depends on FB_MSM_OVERLAY
	bool
	default n

config FB_MSM_MDP_ABL
        bool "Support QCT auto backlight scaling"
        depends on FB_MSM && (MSM_MDP40)
        default n

config MSM_ROTATOR
        tristate "MSM Offline Image Rotator Driver"
        depends on ARCH_MSM7X30 && ANDROID_PMEM
        default y
        help
          This driver provides support for the image rotator HW block in the
          MSM 7x30 SoC.

config MSM_ROTATOR_USE_IMEM
        bool "Enable rotator driver to use iMem"
        depends on MSM_ROTATOR
        default y
        help
          This option enables the msm_rotator driver to use the move efficient
          iMem.  Some MSM platforms may not have iMem available for the rotator
          block.  Or some systems may want the iMem to be dedicated to a
          different function.

config MSM_HDMI_COMMON
	bool "Turn on HDMI common interface"
	depends on FB_MSM_OVERLAY && MSM_MDP40
	bool
	default n

config MSM_HDMI
	bool "Support for HDMI in QCT platform"
	depends on MSM_MDP31 || MSM_MDP40
	default n

config MSM_HDMI_MHL
	bool "Turn on MHL chip driver"
	depends on FB_MSM_OVERLAY && MSM_MDP40
	bool
	default n

config MSM_HDMI_MHL_SII9232
	bool "support sii9232 driver"
	depends on MSM_HDMI_MHL && MSM_MDP40
	bool
	default n

config MDP_UNDERRUN_WORKAROUND_DISABLED
	bool "Disable MDP workaround"
	depends on FB_MSM
	default n

config MDP4_HW_VSYNC
	bool "QCT hardware TE"
	depends on MSM_MDP40
	default n

config MDP_RAISE_CLOCK
	bool "Raise MDP clock when qhd"
	depends on MSM_MDP40
	default n
```

## drivers/video/msm_8x60/Kconfig
```kconfig
source "drivers/video/msm_8x60/sii9234/Kconfig"
config FB_MSM
	tristate
	depends on FB && ARCH_MSM
	select FB_CFB_FILLRECT
	select FB_CFB_COPYAREA
	select FB_CFB_IMAGEBLIT
	default y

config FB_MSM_LEGACY_MDP
	bool
	depends on FB_MSM && (MSM_MDP30 || MSM_MDP31 || MSM_MDP302)
	default y

config FB_MSM_MDP_PPP
	bool
	depends on FB_MSM_LEGACY_MDP
	default y

config FB_MSM_TRIPLE_BUFFER
	bool "Support for triple frame buffer"
	default n

config FB_MSM_LCDC_HW
	bool
	default n

config FB_MSM_LCDC
	bool "Support for integrated LCD controller in qsd8x50 ,MSM7x27 ,MSM7x30 and MSM8x60"
	depends on FB_MSM && (MSM_MDP31 || MSM_MDP302 || MSM_MDP40)
	default n

config FB_MSM_LCDC_PANEL
	bool
	select FB_MSM_LCDC
	default n

config FB_MSM_TVOUT
	bool "Support for TV-Out in qsd8x50"
	depends on FB_MSM && (MSM_MDP31 || MSM_MDP40)
	select FB_MSM_EXT_INTERFACE_COMMON
	default n

config FB_MSM_OVERLAY
	bool "Support for overlay in MSM7X30 and MSM8x60"
	depends on FB_MSM && MSM_MDP40
	default y

config FB_MSM_DTV
	depends on FB_MSM_OVERLAY
	bool
	default n

config FB_MSM_MDP_ABL
        bool "Support QCT auto backlight scaling"
        depends on FB_MSM && (MSM_MDP40)
        default n

choice
	prompt "Default framebuffer color depth"
	depends on MSM_MDP40 || MSM_MDP31
	default FB_MSM_8X60_DEFAULT_DEPTH_RGBA8888

config FB_MSM_8X60_DEFAULT_DEPTH_RGB565
	bool "16 bits per pixel (RGB565)"

config FB_MSM_8X60_DEFAULT_DEPTH_ARGB8888
	bool "32 bits per pixel (ARGB8888)"

config FB_MSM_8X60_DEFAULT_DEPTH_RGBA8888
	bool "32 bits per pixel (RGBA8888)"

endchoice

config FB_MSM_SELF_REFRESH
	bool "Use self refresh"
	depends on FB_MSM
	default n

config FB_MSM_HDMI_MSM_PANEL
	bool "Support for HDMI in QCT platform"
	depends on MSM_MDP40
	select FB_MSM_DTV
	select FB_MSM_EXT_INTERFACE_COMMON
	select FB_MSM_HDMI_COMMON
	select FB_MSM_HDMI_3D
	default n

config FB_MSM_HDMI_MSM_PANEL_DVI_SUPPORT
	bool "Use DVI mode"
	depends on FB_MSM_HDMI_MSM_PANEL
	default n
	---help---
	  Support for DVI mode for MSM HDMI 1080p Panel

config FB_MSM_HDMI_MSM_PANEL_HDCP_SUPPORT
	bool "Use HDCP mode"
	depends on FB_MSM_HDMI_MSM_PANEL
	default n
	---help---
	  Support for HDCP mode for MSM HDMI 1080p Panel
	  Choose to enable HDCP


config FB_MSM_EXT_INTERFACE_COMMON
	bool
	default n

config FB_MSM_HDMI_COMMON
	bool
	default n

config FB_MSM_HDMI_3D
	bool
	default n

config MSM_DSI_CLK_AUTO_CALCULATE
	bool "Use AUTO calculate"
	depends on FB_MSM_MIPI_DSI
	default n

config FB_MSM_MIPI_DSI
	bool
	default n

config FB_MSM_MIPI_DSI_TOSHIBA
	bool
	select FB_MSM_MIPI_DSI
	default n

config FB_MSM_MIPI_DSI_RENESAS
	bool
	select FB_MSM_MIPI_DSI
	default n

config FB_MSM_MIPI_DSI_NOVATEK
	bool
	select FB_MSM_MIPI_DSI
	default n

config FB_MSM_MIPI_DSI_HIMAX
	bool
	select FB_MSM_MIPI_DSI
	default n

config FB_MSM_MIPI_DSI_ORISE
	bool
	select FB_MSM_MIPI_DSI
	default n

config FB_MSM_LCDC_SAMSUNG_WSVGA
	bool
	select FB_MSM_LCDC_PANEL
	default n

config FB_MSM_LCDC_AUO_WVGA
	bool
	select FB_MSM_LCDC_PANEL
	default n 

config FB_MSM_LCDC_AUO_WXGA
	bool
	select FB_MSM_LCDC_PANEL
	default y if MACH_VERDI_LTE

config FB_MSM_MIPI_TOSHIBA_VIDEO_WVGA_PT
	bool
	select FB_MSM_MIPI_DSI_TOSHIBA
	default n

config FB_MSM_MIPI_RENESAS_VIDEO_WVGA_PT
	bool
	select FB_MSM_MIPI_DSI_RENESAS
	default n

config FB_MSM_MIPI_RENESAS_CMD_WVGA_PT
	bool
	select FB_MSM_MIPI_DSI_RENESAS
	default n

config FB_MSM_MIPI_NOVATEK_VIDEO_QHD_PT
	bool
	select FB_MSM_MIPI_DSI_NOVATEK
	default n

config FB_MSM_MIPI_NOVATEK_CMD_QHD_PT
	bool
	select FB_MSM_MIPI_DSI_NOVATEK
	default n

config FB_MSM_MIPI_ORISE_CMD_QHD_PT
	bool
	select FB_MSM_MIPI_DSI_ORISE
	default n

config FB_MSM_MIPI_HIMAX_VIDEO_720P_PT
	bool
	select FB_MSM_MIPI_DSI_HIMAX
	default n

config FB_MSM_MIPI_HIMAX_CMD_720P_PT
	bool
	select FB_MSM_MIPI_DSI_HIMAX
	default n

config FB_MSM_OVERLAY_WRITEBACK
	depends on FB_MSM_OVERLAY
	bool "MDP overlay write back mode enable"
	default y
	---help---
	Support for MDP4 OVERLAY write back mode

config FB_MSM_MIPI_PANEL_DETECT
	depends on ARCH_MSM8X60
	bool
	select FB_MSM_MIPI_RENESAS_CMD_WVGA_PT
	select FB_MSM_MIPI_NOVATEK_CMD_QHD_PT
	select FB_MSM_MIPI_HIMAX_VIDEO_720P_PT
	select FB_MSM_MIPI_ORISE_CMD_QHD_PT
	---help---
	"MIPI Panel Detect + LCDC panel"

config LCDC_TURN_ON_BL_AFTER_PANEL_ON
	bool "Turn On BL again after turn on LCDC panel"
	default n
```

## drivers/video/msm_8x60/sii9234/Kconfig
```kconfig
#
# Miscellaneous I2C chip drivers configuration
#
# *** DEPRECATED! Do not add new entries! See Makefile ***
#

menu "Miscellaneous I2C Chip support II"

config FB_MSM_HDMI_MHL
	depends on FB_MSM_HDMI_MSM_PANEL
	bool "MHL"
	default n
	---help---
	  Support for HDMI output through MHL

config FB_MSM_HDMI_MHL_SII9234
	depends on FB_MSM_HDMI_MHL
	bool "MHL SII9234"
	default n
	---help---
	  Support for HDMI output through MHL SiI9234
	  MHL SII9234 Driver implemented by HTC.

endmenu
```
